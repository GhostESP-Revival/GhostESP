## components/espressif__esp_hosted/slave/sdkconfig.defaults.esp32c5
```kconfig
# 1. CPU
#--------
CONFIG_ESP_DEFAULT_CPU_FREQ_MHZ_240=y

# 2. BT Configuration
#---------------------
CONFIG_BT_ENABLED=y
CONFIG_BT_CONTROLLER_ONLY=y
CONFIG_BT_BLUEDROID_ENABLED=
CONFIG_BT_LE_SLEEP_ENABLE=y

# 3.1 BLE over SPI/SDIO
#-----------------------
CONFIG_BT_LE_HCI_INTERFACE_USE_RAM=y

# 3.2 BLE over UART
#-------------------
# Enable below config, delete sdkconfig, build/ and rebuild
# CONFIG_BT_LE_HCI_INTERFACE_USE_UART=y
# CONFIG_BT_LE_HCI_UART_TX_PIN=5
# CONFIG_BT_LE_HCI_UART_RX_PIN=18
# CONFIG_BT_LE_HCI_UART_FLOWCTRL=n
# #CONFIG_BT_LE_HCI_UART_RTS_PIN=19
# #CONFIG_BT_LE_HCI_UART_CTS_PIN=8


# 4. Partition Table
#--------------------
CONFIG_PARTITION_TABLE_OFFSET=0xc000
CONFIG_PARTITION_TABLE_CUSTOM=y
CONFIG_PARTITION_TABLE_CUSTOM_FILENAME="partitions.esp32c5.csv"

# 5. Mempool
#------------
CONFIG_ESP_CACHE_MALLOC=y


# 6 Network split
#---------------

#CONFIG_ESP_HOSTED_NETWORK_SPLIT_ENABLED=n
#CONFIG_LWIP_TCP_LOCAL_PORT_RANGE_START=61440
#CONFIG_LWIP_TCP_LOCAL_PORT_RANGE_END=65535
#CONFIG_LWIP_UDP_LOCAL_PORT_RANGE_START=61440
#CONFIG_LWIP_UDP_LOCAL_PORT_RANGE_END=65535


# 6.2 LWIP split examples
#-------------------------
#CONFIG_ESP_HOSTED_COPROCESSOR_EXAMPLE_MQTT=n


# 7. Transport config
#---------------------
# CONFIG_ESP_SDIO_NSEND_PSAMPLE=y
# CONFIG_ESP_SDIO_DEFAULT_SPEED=y
# CONFIG_ESP_SDIO_STREAMING_MODE=n


# 8. Wifi config
#----------------
CONFIG_WIFI_CMD_BASIC_ONLY=y

CONFIG_ESP_WIFI_STATIC_RX_BUFFER_NUM=10
CONFIG_ESP_WIFI_DYNAMIC_RX_BUFFER_NUM=64
CONFIG_ESP_WIFI_DYNAMIC_TX_BUFFER_NUM=32
CONFIG_ESP_WIFI_AMPDU_TX_ENABLED=y
CONFIG_ESP_WIFI_TX_BA_WIN=16
CONFIG_ESP_WIFI_AMPDU_RX_ENABLED=y
CONFIG_ESP_WIFI_RX_BA_WIN=16

CONFIG_ESP_WIFI_RX_IRAM_OPT=y
CONFIG_ESP_WIFI_IRAM_OPT=y

# 9. LWIP config
#----------------
CONFIG_LWIP_TCP_SND_BUF_DEFAULT=11520
CONFIG_LWIP_TCP_WND_DEFAULT=11520
CONFIG_LWIP_TCP_RECVMBOX_SIZE=16
CONFIG_LWIP_UDP_RECVMBOX_SIZE=16
CONFIG_LWIP_TCPIP_RECVMBOX_SIZE=32
CONFIG_LWIP_TCP_SACK_OUT=y
CONFIG_LWIP_TCPIP_CORE_LOCKING=y
CONFIG_LWIP_TCPIP_CORE_LOCKING_INPUT=y

# 10. Optimizations
#-------------------
CONFIG_COMPILER_OPTIMIZATION_PERF=y


# 11. Stats
#-----------
#CONFIG_ESP_HOSTED_FUNCTION_PROFILING=y
CONFIG_ESP_PKT_STATS=y

# 12. Priorities
#----------------
CONFIG_IPERF_TRAFFIC_TASK_PRIORITY=18
CONFIG_IPERF_REPORT_TASK_PRIORITY=18


#13. Mem optimizations
#---------------------
CONFIG_FREERTOS_PLACE_FUNCTIONS_INTO_FLASH=y

#13. Mem optimizations
#---------------------
CONFIG_FREERTOS_PLACE_FUNCTIONS_INTO_FLASH=y

# 14. SPIRAM config
#---------------------
# CONFIG_SPIRAM=y
# CONFIG_SPIRAM_MODE_QUAD=y
# CONFIG_SPIRAM_SPEED_80M=y
# CONFIG_SPIRAM_MALLOC_ALWAYSINTERNAL=2000
# CONFIG_SPIRAM_TRY_ALLOCATE_WIFI_LWIP=y
# CONFIG_SPIRAM_MALLOC_RESERVE_INTERNAL=32768
# CONFIG_SPIRAM_ALLOW_BSS_SEG_EXTERNAL_MEMORY=y
# CONFIG_SPIRAM_ALLOW_NOINIT_SEG_EXTERNAL_MEMORY=y

#
# ESP-Hosted - Network coprocessor
#
# CONFIG_ESP_SDIO_RX_Q_SIZE=10
# CONFIG_ESP_SDIO_TX_Q_SIZE=5

# CONFIG_ESP_HOST_DEV_BOARD_P4_C5_CORE=y
```

## components/espressif__esp_hosted/slave/sdkconfig.defaults.esp32c6
```kconfig
# 1. CPU
#--------
CONFIG_ESP_DEFAULT_CPU_FREQ_MHZ_160=y

# 2. BT Configuration
#---------------------
CONFIG_BT_ENABLED=y
CONFIG_BT_CONTROLLER_ONLY=y
CONFIG_BT_BLUEDROID_ENABLED=
CONFIG_BT_LE_SLEEP_ENABLE=y

# 3.1 BLE over SPI/SDIO
#-----------------------
CONFIG_BT_LE_HCI_INTERFACE_USE_RAM=y

# 3.2 BLE over UART
#-------------------
# Enable below config, delete sdkconfig, build/ and rebuild
# CONFIG_BT_LE_HCI_INTERFACE_USE_UART=y
# CONFIG_BT_LE_HCI_UART_TX_PIN=5
# CONFIG_BT_LE_HCI_UART_RX_PIN=12
# CONFIG_BT_LE_HCI_UART_FLOWCTRL=n
# # 4 pin solution is not working yet for c6
# #CONFIG_BT_LE_HCI_UART_RTS_PIN=9
# #CONFIG_BT_LE_HCI_UART_CTS_PIN=13


# 4. Partition Table
#--------------------
CONFIG_PARTITION_TABLE_CUSTOM=y
CONFIG_PARTITION_TABLE_CUSTOM_FILENAME="partitions.esp32c6.csv"

# 5. Mempool
#------------
CONFIG_ESP_CACHE_MALLOC=n


# 6 Network split
#-----------------

#  # 6.1 LWIP split
#  #---------------
#
#  CONFIG_LWIP_TCP_LOCAL_PORT_RANGE_START=61440
#  CONFIG_LWIP_TCP_LOCAL_PORT_RANGE_END=65535
#  CONFIG_LWIP_UDP_LOCAL_PORT_RANGE_START=61440
#  CONFIG_LWIP_UDP_LOCAL_PORT_RANGE_END=65535
#
#  # 6.2 LWIP split examples
#  #-------------------------
#  CONFIG_ESP_HOSTED_COPROCESSOR_EXAMPLE_MQTT=n


# 7. Transport config
#---------------------
# CONFIG_ESP_SDIO_NSEND_PSAMPLE=y
# CONFIG_ESP_SDIO_DEFAULT_SPEED=y
# CONFIG_ESP_SDIO_STREAMING_MODE=n

# For SPI Full duplex C6 on ESP32-P4-Function-EV-Board, please uncomment below
#CONFIG_ESP_HOST_DEV_BOARD_P4_FUNC_BOARD=y
#CONFIG_ESP_SPI_HOST_INTERFACE=y


# 8. Wifi config
#----------------
CONFIG_WIFI_CMD_BASIC_ONLY=y

CONFIG_ESP_WIFI_STATIC_RX_BUFFER_NUM=10
CONFIG_ESP_WIFI_DYNAMIC_RX_BUFFER_NUM=32
CONFIG_ESP_WIFI_DYNAMIC_TX_BUFFER_NUM=32
CONFIG_ESP_WIFI_AMPDU_TX_ENABLED=y
CONFIG_ESP_WIFI_TX_BA_WIN=32
CONFIG_ESP_WIFI_AMPDU_RX_ENABLED=y
CONFIG_ESP_WIFI_RX_BA_WIN=6

CONFIG_ESP_WIFI_RX_IRAM_OPT=y
CONFIG_ESP_WIFI_IRAM_OPT=y

# 9. LWIP config
#----------------
CONFIG_LWIP_TCP_SND_BUF_DEFAULT=11520
CONFIG_LWIP_TCP_WND_DEFAULT=11520
CONFIG_LWIP_TCP_RECVMBOX_SIZE=16
CONFIG_LWIP_UDP_RECVMBOX_SIZE=16
CONFIG_LWIP_TCPIP_RECVMBOX_SIZE=32
CONFIG_LWIP_TCP_SACK_OUT=y
CONFIG_LWIP_TCPIP_CORE_LOCKING=y
CONFIG_LWIP_TCPIP_CORE_LOCKING_INPUT=y


# 10. Optimizations
#-------------------
CONFIG_COMPILER_OPTIMIZATION_PERF=y


# 11. Stats
#-----------
#CONFIG_ESP_HOSTED_FUNCTION_PROFILING=y
#CONFIG_ESP_PKT_STATS=y

###
# OpenThread
#
# Enable this section for co-processor to operate as an OpenThread RCP
###
# CONFIG_OPENTHREAD_ENABLED=y
# CONFIG_OPENTHREAD_RADIO=y
# CONFIG_OPENTHREAD_DIAG=n
# CONFIG_OPENTHREAD_COMMISSIONER=n
# CONFIG_OPENTHREAD_JOINER=n
# CONFIG_OPENTHREAD_BORDER_ROUTER=n
# CONFIG_OPENTHREAD_CLI=n
# CONFIG_OPENTHREAD_SRP_CLIENT=n
# CONFIG_OPENTHREAD_DNS_CLIENT=n
# CONFIG_OPENTHREAD_TASK_SIZE=3072
# CONFIG_OPENTHREAD_CONSOLE_ENABLE=n
# CONFIG_OPENTHREAD_LOG_LEVEL_DYNAMIC=n
#
### enable SW coexistence to allow Wi-Fi and OpenThread to interoperate
#CONFIG_ESP_COEX_SW_COEXIST_ENABLE=y
###
# end of OpenThread configuration
###
```

## components/espressif__esp_hosted/slave/sdkconfig.defaults.esp32h2
```kconfig
# 1. Partition Table
#--------------------
CONFIG_PARTITION_TABLE_OFFSET=0xc000
CONFIG_PARTITION_TABLE_CUSTOM=y
CONFIG_PARTITION_TABLE_CUSTOM_FILENAME="partitions.esp32h2.csv"
```

## components/espressif__esp_hosted/slave/sdkconfig.defaults.esp32s2
```kconfig
# 1. CPU
#--------
#CONFIG_ESP_DEFAULT_CPU_FREQ_MHZ_120=y

# 2. Partition Table
#--------------------
CONFIG_PARTITION_TABLE_CUSTOM=y
CONFIG_PARTITION_TABLE_CUSTOM_FILENAME="partitions.esp32s2.csv"

# 3. Mempool
#------------
CONFIG_ESP_CACHE_MALLOC=y

# 4. Wifi config
#----------------
CONFIG_WIFI_CMD_BASIC_ONLY=y

CONFIG_ESP_WIFI_STATIC_RX_BUFFER_NUM=8
CONFIG_ESP_WIFI_DYNAMIC_RX_BUFFER_NUM=24
CONFIG_ESP_WIFI_DYNAMIC_TX_BUFFER_NUM=24
CONFIG_ESP_WIFI_AMPDU_TX_ENABLED=y
CONFIG_ESP_WIFI_TX_BA_WIN=16
CONFIG_ESP_WIFI_AMPDU_RX_ENABLED=y
CONFIG_ESP_WIFI_RX_BA_WIN=16

CONFIG_ESP_WIFI_RX_IRAM_OPT=y
CONFIG_ESP_WIFI_IRAM_OPT=y

# 5. LWIP config
#----------------
CONFIG_LWIP_TCP_SND_BUF_DEFAULT=17280
CONFIG_LWIP_TCP_WND_DEFAULT=28000
CONFIG_LWIP_TCP_RECVMBOX_SIZE=32
CONFIG_LWIP_UDP_RECVMBOX_SIZE=32
CONFIG_LWIP_TCPIP_RECVMBOX_SIZE=32
CONFIG_LWIP_TCP_SACK_OUT=y
CONFIG_LWIP_TCPIP_CORE_LOCKING=y
CONFIG_LWIP_TCPIP_CORE_LOCKING_INPUT=y


# 6. Optimizations
#-------------------
CONFIG_COMPILER_OPTIMIZATION_SIZE=y
#CONFIG_COMPILER_OPTIMIZATION_PERF=y

# 7. Stats
#-----------
#CONFIG_ESP_HOSTED_FUNCTION_PROFILING=y
CONFIG_ESP_PKT_STATS=y

# 8. Priorities
#--------------
CONFIG_IPERF_TRAFFIC_TASK_PRIORITY=18
CONFIG_IPERF_REPORT_TASK_PRIORITY=18

# 9. Mem optimizations
#---------------------
CONFIG_FREERTOS_PLACE_FUNCTIONS_INTO_FLASH=y

# 10. Bluetooth
#--------------
CONFIG_BT_ENABLED=n
```

## components/espressif__esp_hosted/slave/sdkconfig.defaults.esp32s3
```kconfig
#For battery sensitive usage, can reduce the CPU frequency
CONFIG_ESP32_DEFAULT_CPU_FREQ_240=y
CONFIG_ESP32_DEFAULT_CPU_FREQ_MHZ=240

# BT Configuration
CONFIG_BT_ENABLED=y
CONFIG_BT_CONTROLLER_ONLY=y
CONFIG_BT_BLUEDROID_ENABLED=
CONFIG_BT_LE_SLEEP_ENABLE=y

# Partition
CONFIG_PARTITION_TABLE_CUSTOM=y
CONFIG_PARTITION_TABLE_CUSTOM_FILENAME="partitions.esp32s3.csv"

# Wifi config
CONFIG_WIFI_CMD_BASIC_ONLY=y
CONFIG_ESP_WIFI_STATIC_RX_BUFFER_NUM=10
CONFIG_ESP_WIFI_DYNAMIC_RX_BUFFER_NUM=32
CONFIG_ESP_WIFI_DYNAMIC_TX_BUFFER_NUM=32
CONFIG_ESP_WIFI_AMPDU_TX_ENABLED=y
CONFIG_ESP_WIFI_TX_BA_WIN=32
CONFIG_ESP_WIFI_AMPDU_RX_ENABLED=y
CONFIG_ESP_WIFI_RX_BA_WIN=6
CONFIG_ESP_WIFI_RX_IRAM_OPT=y
CONFIG_ESP_WIFI_IRAM_OPT=y

# LWIP config
CONFIG_LWIP_TCP_SND_BUF_DEFAULT=11520
CONFIG_LWIP_TCP_WND_DEFAULT=11520
CONFIG_LWIP_TCP_RECVMBOX_SIZE=16
CONFIG_LWIP_UDP_RECVMBOX_SIZE=16
CONFIG_LWIP_TCPIP_RECVMBOX_SIZE=32
CONFIG_LWIP_TCP_SACK_OUT=y
CONFIG_LWIP_TCPIP_CORE_LOCKING=y
CONFIG_LWIP_TCPIP_CORE_LOCKING_INPUT=y


# Optimizations
CONFIG_COMPILER_OPTIMIZATION_PERF=y
```

## main/Kconfig.projbuild
```kconfig
menu "Ghost ESP Options"

    menu "Device Detials"

    config BUILD_CONFIG_TEMPLATE
        string "Specify template used to build"
        default "unknown_board"
        help
            Specify GESP build config template that was used at build time.
    endmenu
    
    menu "LED Options"
    
    config USE_NEOPIXEL
        bool "Use Neopixel RGB LEDs"
        default n
        help
            Enable Neopixel RGB LED support. When enabled, a single data pin will be used for RGB control.
    
    config LED_DATA_PIN
        int "LED Data Pin"
        default 0
        depends on USE_NEOPIXEL
        help
            Set the data pin for Neopixel LEDs.
    
    config NUM_LEDS
        int "Number of LEDs"
        default 0
        help
            Set the number of LEDs connected.
    
    config RED_RGB_PIN
        int "Red RGB Pin"
        default 0
        depends on !USE_NEOPIXEL
        help
            Define the pin for the red color of RGB LED when not using Neopixel.
    
    config GREEN_RGB_PIN
        int "Green RGB Pin"
        default 0
        depends on !USE_NEOPIXEL
        help
            Define the pin for the green color of RGB LED when not using Neopixel.
    
    config BLUE_RGB_PIN
        int "Blue RGB Pin"
        default 0
        depends on !USE_NEOPIXEL
        help
            Define the pin for the blue color of RGB LED when not using Neopixel.
    
    endmenu
    
    menu "Display Options"
    
    config WITH_SCREEN
        bool "Enable Screen Support"
        default n
        help
            Enable or disable screen support.
    
    config TFT_WIDTH
        int "TFT Width"
        default 240
        depends on WITH_SCREEN
        help
            Set the width of the TFT display.
    
    config TFT_HEIGHT
        int "TFT Height"
        default 320
        depends on WITH_SCREEN
        help
            Set the height of the TFT display.

    config USE_TOUCHSCREEN
        bool "Enable Touchscreen"
        default n
        help
            Enable touchscreen input.

    config USE_7_INCHER
        bool "Use 7-inch Display"
        default n
        help
            Set to enable 7-inch display support.

    config Waveshare_LCD
        bool "Enable Waveshare LCD"
        default n
        help
            Enable support for Waveshare LCD.

    config Crowtech_LCD
        bool "Enable Crowtech LCD"
        default n
        help
            Enable support for Crowtech LCD.

    config Sunton_LCD
        bool "Enable Sunton LCD"
        default n
        help
            Enable support for Sunton LCD.

    config JC3248W535EN_LCD
        bool "Enable JC3248W535EN LCD"
        default n
        help
            Enable support for JC3248W535EN LCD.

    config USE_ILI9341_2
        bool "Use ILI9341 2nd Display Driver"
        default n
        help
            Enable support for ILI9341 display module.

    config WITH_STATUS_DISPLAY
        bool "Enable Status Display"
        default n
        help
            Enable the secondary status display that shares the IO expander I2C bus.

    config STATUS_DISPLAY_SDA_PIN
        int "Status Display SDA Pin"
        default 6
        depends on WITH_STATUS_DISPLAY
        help
            Set the SDA pin for the status OLED display (shares IO expander bus).

    config STATUS_DISPLAY_SCL_PIN
        int "Status Display SCL Pin"
        default 7
        depends on WITH_STATUS_DISPLAY
        help
            Set the SCL pin for the status OLED display (shares IO expander bus).

    config STATUS_DISPLAY_I2C_PORT
        int "Status Display I2C Port"
        range 0 1
        default 0
        depends on WITH_STATUS_DISPLAY
        help
            Select the I2C controller port used for the status OLED display.

    config STATUS_DISPLAY_I2C_ADDRESS
        hex "Status Display I2C Address"
        default 0x3C
        depends on WITH_STATUS_DISPLAY
        help
            Set the I2C address for the status OLED.

    config STATUS_DISPLAY_ROTATE_180
        bool "Rotate status display 180 degrees"
        default n
        depends on WITH_STATUS_DISPLAY
        help
            Rotate only the secondary status OLED by 180 degrees. Does not
            affect the primary TFT/touch display.

    config STATUS_DISPLAY_POWER_PIN
        int "Status Display Power Control Pin (Vext)"
        default -1
        depends on WITH_STATUS_DISPLAY
        help
            GPIO pin for power control (e.g., Vext on Heltec V3). Set to -1 to disable.
            For Heltec V3, this should be GPIO36. LOW = display ON, HIGH = display OFF.

    config STATUS_DISPLAY_RESET_PIN
        int "Status Display Reset Pin"
        default -1
        depends on WITH_STATUS_DISPLAY
        help
            GPIO pin for display reset. Set to -1 to disable.
            For Heltec V3, this should be GPIO21.

    endmenu

    menu "Misc Options"

        config USE_JOYSTICK
            bool "Enable Joystick"
            default n
            help
                Enable joystick input.
                
        config USE_IO_EXPANDER
            bool "Enable IO Expander (TCA9535)"
            default n
            depends on USE_JOYSTICK
            help
                Enable TCA9535 IO expander for joystick input via I2C.
                
        config IO_EXPANDER_SDA_PIN
            int "IO Expander SDA Pin"
            default 6
            depends on USE_IO_EXPANDER
            help
                Set the SDA pin for the TCA9535 IO expander.
                
        config IO_EXPANDER_SCL_PIN
            int "IO Expander SCL Pin"
            default 7
            depends on USE_IO_EXPANDER
            help
                Set the SCL pin for the TCA9535 IO expander.
                
        config IO_EXPANDER_I2C_ADDR
            hex "IO Expander I2C Address"
            default 0x74
            depends on USE_IO_EXPANDER
            help
                Set the I2C address for the TCA9535 IO expander.
                
        config L_BTN
            int "Left button data pin"
            default 0
            depends on USE_JOYSTICK
            help
                Set the data pin for left button
        config R_BTN
            int "Right button data pin"
            default 0
            depends on USE_JOYSTICK
            help
                Set the data pin for right button
        config U_BTN
            int "Up button data pin"
            default 0
            depends on USE_JOYSTICK
            help
                Set the data pin for up button
        config D_BTN
            int "Down button data pin"
            default 0
            depends on USE_JOYSTICK
            help
                Set the data pin for down button
        config C_BTN
            int "Center button data pin"
            default 0
            depends on USE_JOYSTICK
            help
                Set the data pin for center button
                
        config USE_TDECK
            bool "Enable TDECK-plus"
            default n
            help
                Enable tdeck logics.
    
        config USE_CARDPUTER
            bool "Enable Cardputer"
            default n
            help
                Enable Cardputer input.

        config USE_CARDPUTER_ADV
            bool "Enable Cardputer ADV (TCA8418 keyboard)"
            default n
            help
                Enable Cardputer ADV keyboard support using the TCA8418 keypad controller.
        
        config USE_TDISPLAY_S3
            bool "Enable T-Display S3"
            default n
            help
                Enable support for LilyGo T-Display S3 with ST7789 display and CST816 touch.
        
        config USE_HW_KB
            bool "Enable Hardware Keyboard"
            default n
            help
                Enable hardware keyboard input ui elements.

        config USE_USB_KEYBOARD
            bool "Enable USB HID Keyboard (host)"
            default n
            depends on IDF_TARGET_ESP32S3
            help
                Enable USB host HID keyboard support and stream key events over Dual Comm.

        config USB_KBD_DMINUS_PIN
            int "USB Keyboard D- Pin"
            default 19
            depends on USE_USB_KEYBOARD
            help
                GPIO pin for USB D- (keyboard). On ESP32-S3 this is normally GPIO19.

        config USB_KBD_DPLUS_PIN
            int "USB Keyboard D+ Pin"
            default 20
            depends on USE_USB_KEYBOARD
            help
                GPIO pin for USB D+ (keyboard). On ESP32-S3 this is normally GPIO20.

        config HAS_BATTERY
            bool "Enable power saving"
            default n
            help
                Enable power saving features if you have a battery.


        config HAS_BATTERY_ADC
            bool "Enable battery ADC reading"
            default n
            help
                Enable ADC battery readings
                
        config ADC_BATTERY_PIN
            int "Pin for reading ADC measurements"
            default -1
            depends on HAS_BATTERY_ADC
            help
                Set ADC battery pin (GPIO4 for T-Deck, GPIO10 for Cardputer)

        config HAS_FUEL_GAUGE
            bool "Enable Fuel Gauge Support"
            default n
            help
                Enable fuel gauge support for accurate battery monitoring.

        config USE_BQ27220_FUEL_GAUGE
            bool "Use BQ27220 Fuel Gauge"
            default n
            depends on HAS_FUEL_GAUGE
            help
                Enable support for BQ27220 fuel gauge via I2C.

        config BQ27220_I2C_ADDRESS
            hex "BQ27220 I2C Address"
            default 0x55
            depends on USE_BQ27220_FUEL_GAUGE
            help
                I2C address for BQ27220 fuel gauge (default 0x55).

        config BQ27220_I2C_SDA_PIN
            int "BQ27220 I2C SDA Pin"
            default 8
            depends on USE_BQ27220_FUEL_GAUGE
            help
                GPIO pin for BQ27220 I2C SDA line.

        config BQ27220_I2C_SCL_PIN
            int "BQ27220 I2C SCL Pin"
            default 18
            depends on USE_BQ27220_FUEL_GAUGE
            help
                GPIO pin for BQ27220 I2C SCL line.

        config BQ27220_DESIGN_CAPACITY
            int "Battery Design Capacity (mAh)"
            default 1300
            depends on USE_BQ27220_FUEL_GAUGE
            help
                Design capacity of the battery in mAh (default 1300 for T-Embed CC1101).
    
        config HAS_RTC_CLOCK
            bool "Enable RTC Clock"
            default n
            help
                Enable RTC Clock.

        config WITH_ETHERNET
            bool "Enable Ethernet Support"
            default n
            help
                Enable Ethernet Support.
                
        config ETH_W5500_MOSI_PIN
            int "W5500 MOSI Pin"
            default 6
            depends on WITH_ETHERNET
            help
                Set the GPIO pin for W5500 MOSI (Master Out Slave In).
                
        config ETH_W5500_MISO_PIN
            int "W5500 MISO Pin"
            default 5
            depends on WITH_ETHERNET
            help
                Set the GPIO pin for W5500 MISO (Master In Slave Out).
                
        config ETH_W5500_SCK_PIN
            int "W5500 SCK Pin"
            default 4
            depends on WITH_ETHERNET
            help
                Set the GPIO pin for W5500 SCK (Serial Clock).
                
        config ETH_W5500_CS_PIN
            int "W5500 CS Pin"
            default 15
            depends on WITH_ETHERNET
            help
                Set the GPIO pin for W5500 CS (Chip Select).
                
        config ETH_W5500_INT_PIN
            int "W5500 INT Pin (optional, use -1 to disable)"
            default 7
            depends on WITH_ETHERNET
            help
                Set the GPIO pin for W5500 INT (Interrupt). Use -1 if not connected.
            
        config IS_GHOST_BOARD
            bool "Enable Ghost Board Configuration"
            default n
            help
                Enable configuration for Ghost board.

        config IS_S3TWATCH
            bool "Enable S3TWatch Configuration"
            default n
            help
                Enable configuration for S3TWatch with virtual flash storage.

        config HAS_INFRARED
            bool "Enable Infrared Support"
            default n
            help
                Enable infrared hardware and UI support.

        config INFRARED_LED_PIN
            int "Infrared LED Pin"
            default 0
            depends on HAS_INFRARED
            help
                Set the GPIO pin used for IR LED transmission and indication.

        config HAS_INFRARED_RX
            bool "Enable Infrared Receive Support"
            default n
            depends on HAS_INFRARED
            help
                Enable infrared receive functionality for learning remote signals.

        config INFRARED_RX_PIN
            int "Infrared RX Pin"
            default 0
            depends on HAS_INFRARED_RX
            help
                Set the GPIO pin used for IR signal reception.

        config USE_ENCODER
            bool "Enable Encoder Input"
            default n
            help
                Enable support for rotary encoder input.

        config ENCODER_INA
            int "Encoder INA Pin"
            default 4
            depends on USE_ENCODER
            help
                Set the GPIO pin for Encoder INA.

        config ENCODER_INB
            int "Encoder INB Pin"
            default 5
            depends on USE_ENCODER
            help
                Set the GPIO pin for Encoder INB.

        config ENCODER_KEY
            int "Encoder Key Pin"
            default 0
            depends on USE_ENCODER
            help
                Set the GPIO pin for the Encoder button.

        menu "NFC Options"

            config NFC_PN532
                bool "Enable PN532 NFC"
                default n
                help
                    Enable PN532 NFC support.

            config NFC_CHAMELEON
                bool "Enable Chameleon Ultra NFC"
                default y if BT_BLE_ENABLED
                default n
                help
                    Enable using Chameleon Ultra as an NFC backend over BLE.

            # Aggregated flag for UI and generic NFC code
            config HAS_NFC
                bool
                default y if NFC_PN532 || NFC_CHAMELEON

            config NFC_SCL_PIN
                int "NFC Clock Pin (SCL/SCK)"
                default 22
                depends on NFC_PN532
                help
                    GPIO for PN532 I2C clock (aka SCL/SCK).

            config NFC_SDA_PIN
                int "NFC Data Pin (SDA)"
                default 21
                depends on NFC_PN532
                help
                    GPIO for PN532 I2C data (SDA).

            config NFC_IRQ_PIN
                int "NFC URQ/IRQ Pin"
                default -1
                depends on NFC_PN532
                help
                    GPIO for PN532 IRQ (aka URQ). Use -1 if not connected.

            config NFC_RST_PIN
                int "NFC RF RST Pin"
                default -1
                depends on NFC_PN532
                help
                    GPIO for PN532 reset (RF RST). Use -1 if not connected.

        endmenu

    endmenu
    
    menu "GPS Configuration"
    
    config HAS_GPS
        bool "Enable GPS"
        default n
        help
            Enable GPS support.
    
    config GPS_UART_RX_PIN
        int "GPS UART RX Pin"
        default 16
        depends on HAS_GPS
        help
            Define the UART RX pin for GPS.
    
    config GPS_UART_BAUD_RATE
        int "Set baud rate for gps serial"
        default 9600
        depends on HAS_GPS
        help
            Define the UART RX pin baud rate for GPS.

    config NMEA_PARSER_RING_BUFFER_SIZE
        int "NMEA Parser Ring Buffer Size"
        range 0 2048
        depends on HAS_GPS
        default 1024
        help
            Size of the ring buffer used for UART Rx channel.

    config NMEA_PARSER_TASK_STACK_SIZE
        int "NMEA Parser Task Stack Size"
        range 0 4096
        depends on HAS_GPS
        default 3072
        help
            Stack size of NMEA Parser task.

    config NMEA_PARSER_TASK_PRIORITY
        int "NMEA Parser Task Priority"
        range 0 24
        depends on HAS_GPS
        default 2
        help
            Priority of NMEA Parser task.

    menu "NMEA Statement Support"
        comment "At least one statement must be selected"
        config NMEA_STATEMENT_GGA
            bool "GGA Statement"
            default y
            depends on HAS_GPS
            help
                Enabling this option will parse the following parameter from GGA statement:

                - Latitude, Longitude, Altitude;
                - Number of satellites in use, fix status (no fix, GPS, DGPS), UTC time;

        config NMEA_STATEMENT_GSA
            bool "GSA Statement"
            default y
            depends on HAS_GPS
            help
                Enabling this option will parse the following parameter from GSA statement:

                - Position/Vertical/Horizontal dilution of precision;
                - Fix mode (no fix, 2D, 3D fix);
                - IDs of satellites in use;

        config NMEA_STATEMENT_GSV
            bool "GSV Statement"
            default y
            depends on HAS_GPS
            help
                Enabling this option will parse the following parameter from GSV statement:

                - Number of satellites in view;
                - Optional details of each satellite in view;

        config NMEA_STATEMENT_RMC
            bool "RMC Statement"
            default y
            depends on HAS_GPS
            help
                Enabling this option will parse the following parameter from RMC statement:

                - Validity of GPS signal;
                - Ground speed (knots) and course over ground (degrees);
                - Magnetic variation;
                - UTC date;

        config NMEA_STATEMENT_GLL
            bool "GLL Statement"
            default y
            depends on HAS_GPS
            help
                Enabling this option will parse the following parameter from GLL statement:

                - Latitude, Longitude;
                - UTC time;

        config NMEA_STATEMENT_VTG
            bool "VTG Statement"
            default y
            depends on HAS_GPS
            help
                Enabling this option will parse the following parameter from VTG statement:

                - Ground speed (knots, km/h) and course over ground (degrees);
                - Magnetic variation;

    endmenu
    
    endmenu
    
    menu "SPI and MMC Configuration"
    
    config USING_SPI
        bool "Enable SPI"
        default n
        help
            Enable SPI communication.
    
    config USING_MMC
        bool "Enable MMC"
        default n
        help
            Enable MMC support.

    config USING_MMC_1_BIT
        bool "Enable MMC (1-bit mode)"
        default n
        help
            Enable MMC support (1-bit mode).
    
    config SD_SPI_CS_PIN
        int "SD Card SPI CS Pin"
        default 4
        depends on USING_SPI
        help
            Define the Chip Select (CS) pin for SD Card SPI.
    
    config SD_SPI_CLK_PIN
        int "SD Card SPI CLK Pin"
        default 18
        depends on USING_SPI
        help
            Define the Clock (CLK) pin for SD Card SPI.
    
    config SD_SPI_MISO_PIN
        int "SD Card SPI MISO Pin"
        default 19
        depends on USING_SPI
        help
            Define the MISO pin for SD Card SPI.
    
    config SD_SPI_MOSI_PIN
        int "SD Card SPI MOSI Pin"
        default 23
        depends on USING_SPI
        help
            Define the MOSI pin for SD Card SPI.

    config SD_MMC_D0 
        int "SD Card D0 Pin"
        default 13
        depends on USING_MMC_1_BIT
        help
            Define the MOSI pin for SD Card SPI.
            
    config SD_MMC_CLK
        int "SD Card CLK Pin"
        default 12
        depends on USING_MMC_1_BIT
        help
            Define the MISO pin for SD Card SPI.
            
    config SD_MMC_CMD 
        int "SD Card CMD Pin"
        default 11
        depends on USING_MMC_1_BIT
        help
            Define the MOSI pin for SD Card SPI.
    
    endmenu
    
endmenu    
```

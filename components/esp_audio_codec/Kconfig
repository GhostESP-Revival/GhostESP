## components/esp_audio_codec/Kconfig
```kconfig
menu "Audio Codec Configuration"
    menu "Audio Decoder Configuration"
        config AUDIO_DECODER_AAC_SUPPORT
            bool "Support AAC Decoder"
            default y
            help
                Enable this option to register AAC decoder

        config AUDIO_DECODER_MP3_SUPPORT
            bool "Support MP3 Decoder"
            default y
            help
                Enable this option to register MP3 decoder
        
        config AUDIO_DECODER_G711_SUPPORT
            bool "Support G711 Decoder"
            default y
            help
                Enable this option to register G711 A-Law and U-Law decoder

        config AUDIO_DECODER_AMRNB_SUPPORT
            bool "Support AMR-NB Decoder"
            default y
            help
                Enable this option to register AMR-NB decoder
        
        config AUDIO_DECODER_AMRWB_SUPPORT
            bool "Support AMR-WB Decoder"
            default y
            help
                Enable this option to register AMR-WB decoder

        config AUDIO_DECODER_FLAC_SUPPORT
            bool "Support FLAC Decoder"
            default y
            help
                Enable this option to register FLAC decoder

        config AUDIO_DECODER_OPUS_SUPPORT
            bool "Support OPUS Decoder"
            default y
            help
                Enable this option to register OPUS decoder

        config AUDIO_DECODER_VORBIS_SUPPORT
            bool "Support VORBIS Decoder"
            default y
            help
                Enable this option to register VORBIS decoder

        config AUDIO_DECODER_ADPCM_SUPPORT
            bool "Support ADPCM Decoder"
            default y
            help
                Enable this option to register IMA-ADPCM decoder
        config AUDIO_DECODER_ALAC_SUPPORT
            bool "Support ALAC Decoder"
            default y
            help
                Enable this option to register ALAC decoder
        config AUDIO_DECODER_PCM_SUPPORT
            bool "Support PCM Decoder"
            default y
            help
                Enable this option to register PCM decoder
        config AUDIO_DECODER_SBC_SUPPORT
            bool "Support SBC Decoder"
            default y
            help
                Enable this option to register SBC decoder
        config AUDIO_DECODER_LC3_SUPPORT
            bool "Support LC3 Decoder"
            default y
            help
                Enable this option to register LC3 decoder
        config AUDIO_DECODER_G722_SUPPORT
            bool "Support G722 Decoder"
            default y
            help
                Enable this option to register G722 decoder
    endmenu

    menu "Audio Simple Decoder Configuration"
        config AUDIO_SIMPLE_DEC_WAV_SUPPORT
            bool "Support WAV Container"
            default y
            help
                Support decode audio frame from WAV container

        config AUDIO_SIMPLE_DEC_M4A_SUPPORT
            bool "Support MP4 Container"
            default y
            help
                Support decode audio frame from MP4 container
        
        config AUDIO_SIMPLE_DEC_TS_SUPPORT
            bool "Support TS Container"
            default y
            help
                Support decode audio frame from TS container
        
        config AUDIO_SIMPLE_DEC_OGG_SUPPORT
            bool "Support OGG Container"
            default y
            help
                Support decode audio frame from OGG container
    endmenu

    menu "Audio Encoder Configuration"
        config AUDIO_ENCODER_AAC_SUPPORT
            bool "Support AAC Encoder"
            default y
            help
                Enable this option to register AAC Encoder

        config AUDIO_ENCODER_G711_SUPPORT
            bool "Support G711 Encoder"
            default y
            help
                Enable this option to register G711 A-Law and U-Law encoder

        config AUDIO_ENCODER_AMRNB_SUPPORT
            bool "Support AMR-NB Encoder"
            default y
            help
                Enable this option to register AMR-NB encoder
        
        config AUDIO_ENCODER_AMRWB_SUPPORT
            bool "Support AMR-WB Encoder"
            default y
            help
                Enable this option to register AMR-WB encoder

        config AUDIO_ENCODER_OPUS_SUPPORT
            bool "Support OPUS Encoder"
            default y
            help
                Enable this option to register OPUS encoder

        config AUDIO_ENCODER_ADPCM_SUPPORT
            bool "Support ADPCM Encoder"
            default y
            help
                Enable this option to register IMA-ADPCM encoder
        config AUDIO_ENCODER_ALAC_SUPPORT
            bool "Support ALAC Encoder"
            default y
            help
                Enable this option to register ALAC encoder
        config AUDIO_ENCODER_PCM_SUPPORT
            bool "Support PCM Encoder"
            default y
            help
                Enable this option to register PCM encoder
        config AUDIO_ENCODER_SBC_SUPPORT
            bool "Support SBC Encoder"
            default y
            help
                Enable this option to register SBC encoder
        config AUDIO_ENCODER_LC3_SUPPORT
            bool "Support LC3 Encoder"
            default y
            help
                Enable this option to register LC3 encoder
        config AUDIO_ENCODER_G722_SUPPORT
            bool "Support G722 Encoder"
            default y
            help
                Enable this option to register G722 encoder
    endmenu
    
 endmenu
```

## components/espressif__esp_hosted/examples/host_hosted_cp_meminfo/main/Kconfig.projbuild
```kconfig
menu "Example Configuration"

	config EXAMPLE_MEM_MONITOR_QUERY_ONLY_ONCE
	 	bool "Query Memory Info only once"
		default n
		help
			Query the memory on the co-processor only once

	if !EXAMPLE_MEM_MONITOR_QUERY_ONLY_ONCE

	config EXAMPLE_MEM_MONITOR_INTERVAL_SEC
	 	int "Memory Monitor Interval (in seconds)"
		default 10
		help
			Set the interval for doing memory checks on the co-processor

	config EXAMPLE_MEM_MONITOR_REPORT_ALWAYS
	 	bool "Always send a memory report"
		default y
		help
			When enabled, co-processor will always send a memory report while doing the memory check at the set interval. When disable, co-processor will only send a memory report if memory check shows memory has dropped below a set threshold

	config EXAMPLE_MEM_MONITOR_INTERNAL_DMA_THRESHOLD
		depends on !EXAMPLE_MEM_MONITOR_REPORT_ALWAYS
		int "Threshold for internal DMA Heap Memory (in bytes)"
		default 8192
		help
			Sets the memory threshold that will trigger a report. 0 disables the threshold.

	config EXAMPLE_MEM_MONITOR_INTERNAL_8BIT_THRESHOLD
		depends on !EXAMPLE_MEM_MONITOR_REPORT_ALWAYS
		int "Threshold for internal 8-Bit Heap Memory (in bytes)"
		default 8192
		help
			Sets the memory threshold that will trigger a report. 0 disables the threshold.

	config EXAMPLE_MEM_MONITOR_EXTERNAL_DMA_THRESHOLD
		depends on !EXAMPLE_MEM_MONITOR_REPORT_ALWAYS
		int "Threshold for external DMA Heap Memory (in bytes)"
		default 8192
		help
			Sets the memory threshold that will trigger a report. 0 disables the threshold.

	config EXAMPLE_MEM_MONITOR_EXTERNAL_8BIT_THRESHOLD
		depends on !EXAMPLE_MEM_MONITOR_REPORT_ALWAYS
		int "Threshold for external 8-Bit Heap Memory (in bytes)"
		default 8192
		help
			Sets the memory threshold that will trigger a report. 0 disables the threshold.

	endif

	menu "Wifi Config"

		config ESP_WIFI_SSID
			string "WiFi SSID"
			default "myssid"
			help
				SSID (network name) for the example to connect to.

		config ESP_WIFI_PASSWORD
			string "WiFi Password"
			default "mypassword"
			help
				WiFi password (WPA or WPA2) for the example to use.

		choice ESP_WIFI_SAE_MODE
			prompt "WPA3 SAE mode selection"
			default ESP_STATION_EXAMPLE_WPA3_SAE_PWE_BOTH
			help
				Select mode for SAE as Hunt and Peck, H2E or both.
			config ESP_STATION_EXAMPLE_WPA3_SAE_PWE_HUNT_AND_PECK
				bool "HUNT AND PECK"
			config ESP_STATION_EXAMPLE_WPA3_SAE_PWE_HASH_TO_ELEMENT
				bool "H2E"
				depends on ESP_WIFI_ENABLE_SAE_H2E
			config ESP_STATION_EXAMPLE_WPA3_SAE_PWE_BOTH
				bool "BOTH"
				depends on ESP_WIFI_ENABLE_SAE_H2E
		endchoice

		config ESP_WIFI_PW_ID
			string "PASSWORD IDENTIFIER"
			depends on  ESP_STATION_EXAMPLE_WPA3_SAE_PWE_HASH_TO_ELEMENT|| ESP_STATION_EXAMPLE_WPA3_SAE_PWE_BOTH
			default ""
			help
				password identifier for SAE H2E

		config ESP_MAXIMUM_RETRY
			int "Maximum retry"
			default 5
			help
				Set the Maximum retry to avoid station reconnecting to the AP unlimited when the AP is really inexistent.

		choice ESP_WIFI_SCAN_AUTH_MODE_THRESHOLD
			prompt "WiFi Scan auth mode threshold"
			default ESP_WIFI_AUTH_WPA2_PSK
			help
				The weakest authmode to accept in the scan mode.
				This value defaults to ESP_WIFI_AUTH_WPA2_PSK in case password is present and ESP_WIFI_AUTH_OPEN is used.
				Please select ESP_WIFI_AUTH_WEP/ESP_WIFI_AUTH_WPA_PSK in case AP is operating in WEP/WPA mode.

			config ESP_WIFI_AUTH_OPEN
				bool "OPEN"
			config ESP_WIFI_AUTH_WEP
				bool "WEP"
			config ESP_WIFI_AUTH_WPA_PSK
				bool "WPA PSK"
			config ESP_WIFI_AUTH_WPA2_PSK
				bool "WPA2 PSK"
			config ESP_WIFI_AUTH_WPA_WPA2_PSK
				bool "WPA/WPA2 PSK"
			config ESP_WIFI_AUTH_WPA3_PSK
				bool "WPA3 PSK"
			config ESP_WIFI_AUTH_WPA2_WPA3_PSK
				bool "WPA2/WPA3 PSK"
			config ESP_WIFI_AUTH_WAPI_PSK
				bool "WAPI PSK"
		endchoice
	endmenu
endmenu
```

## components/espressif__esp_hosted/examples/host_openthread_border_router/sdkconfig.defaults.esp32p4
```kconfig
# Increase size of bootloader due to frame pointer. Only overflowed on P4.
CONFIG_PARTITION_TABLE_OFFSET=0x9000

### enable SPIRAM, else application will not start (out of memory)
CONFIG_SPIRAM=y
CONFIG_ESP_HOSTED_DFLT_TASK_FROM_SPIRAM=y

### enable Wi-Fi in example, set co-processor target
CONFIG_EXAMPLE_CONNECT_WIFI=y
CONFIG_SLAVE_IDF_TARGET_ESP32C6=y

CONFIG_ESP_CONSOLE_UART_DEFAULT=y
```

## components/espressif__esp_hosted/examples/host_openthread_cli/sdkconfig.defaults.esp32p4
```kconfig
CONFIG_PARTITION_TABLE_CUSTOM=y
CONFIG_PARTITION_TABLE_CUSTOM_FILENAME="partitions.esp32p4.csv"
CONFIG_PARTITION_TABLE_FILENAME="partitions.esp32p4.csv"
CONFIG_ESPTOOLPY_FLASHSIZE_4MB=y

### enable SPIRAM, else application will not start (out of memory)
CONFIG_SPIRAM=y
CONFIG_ESP_HOSTED_DFLT_TASK_FROM_SPIRAM=y
```

## components/espressif__esp_hosted/examples/host_wifi_easy_connect_dpp_enrollee/sdkconfig.defaults.esp32p4
```kconfig
#
# ESP32-P4 specific
#

CONFIG_SLAVE_IDF_TARGET_ESP32C6=y
CONFIG_ESP_HOSTED_P4_DEV_BOARD_FUNC_BOARD=y
```

## components/espressif__esp_hosted/slave/main/Kconfig.light_sleep
```kconfig
menu "Light Sleep Power Management"

	choice ESP_HOSTED_LIGHT_SLEEP_POWER_MODE
		prompt "Light Sleep Power Management"
		default ESP_HOSTED_LIGHT_SLEEP_POWER_DISABLED
		help
			Configure light sleep power management for the slave device.

			Light sleep suspends the CPU while peripherals like WiFi and Bluetooth
			can remain operational (if modem sleep is enabled).

			MODES:
			• Disabled: No light sleep (default)
			• Minimum: Auto-setup for development (console active)
			• Maximum: Auto-setup for production (max power saving)
			• Manual: Configure everything yourself

		config ESP_HOSTED_LIGHT_SLEEP_POWER_DISABLED
			bool "Disabled"
			help
				Light sleep is disabled.
				Use this if you don't need power management.

		config ESP_HOSTED_LIGHT_SLEEP_POWER_MIN
			bool "Minimum Power Saving (development mode)"
			select PM_ENABLE
			select FREERTOS_USE_TICKLESS_IDLE
			select ESP_PHY_MAC_BB_PD if BT_ENABLED
			select BTDM_CTRL_MODEM_SLEEP if BT_ENABLED && IDF_TARGET_ESP32
			select BT_LE_SLEEP_ENABLE if BT_ENABLED && !IDF_TARGET_ESP32
			help
				✓ One-click setup for development

				AUTO-ENABLES:
				• Power Management
				• FreeRTOS Tickless Idle
				• BT power saving (if BT enabled)

				FEATURES:
				• UART console active during sleep
				• Easy debugging
				• Moderate power saving

		config ESP_HOSTED_LIGHT_SLEEP_POWER_MAX
			bool "Maximum Power Saving (production mode)"
			select PM_ENABLE
			select FREERTOS_USE_TICKLESS_IDLE
			select ESP_PHY_MAC_BB_PD if BT_ENABLED
			select BTDM_CTRL_MODEM_SLEEP if BT_ENABLED && IDF_TARGET_ESP32
			select BT_LE_SLEEP_ENABLE if BT_ENABLED && !IDF_TARGET_ESP32
			select PM_POWER_DOWN_PERIPHERAL_IN_LIGHT_SLEEP
			select ESP_HOSTED_LIGHT_SLEEP_PERIPHERAL_POWERDOWN
			help
				✓ One-click setup for production

				AUTO-ENABLES:
				• All Minimum mode settings, plus:
				• Peripheral power down in light sleep

				FEATURES:
				• Maximum power efficiency
				• UART console disabled during sleep
				• Best for battery applications

				NOTE: Configure additional ESP-Hosted options below for optimal power.

		config ESP_HOSTED_LIGHT_SLEEP_POWER_MANUAL
			bool "Manual (I'll configure everything myself)"
			help
				Advanced mode: Configure each power option individually.

				You must manually enable:
				• Power Management
				• FreeRTOS Tickless Idle
				• BT power features (if using BT)
	endchoice

	# Helper config for code to check if light sleep is enabled at all
	config ESP_HOSTED_LIGHT_SLEEP_ENABLE
		bool
		default y if ESP_HOSTED_LIGHT_SLEEP_POWER_MIN || ESP_HOSTED_LIGHT_SLEEP_POWER_MAX || ESP_HOSTED_LIGHT_SLEEP_POWER_MANUAL
		default n

	menu "Light Sleep Parameters"
		depends on ESP_HOSTED_LIGHT_SLEEP_ENABLE

		# Only show prerequisite warnings in MANUAL mode
		if ESP_HOSTED_LIGHT_SLEEP_POWER_MANUAL
			comment "━━━━━━━━━━━━━━━━━━━━━━━━━━━━━━━━━━━━━━━━━━━━━━━━━━━━"
			comment "• Manual Mode: Check Prerequisites Below"
			comment "━━━━━━━━━━━━━━━━━━━━━━━━━━━━━━━━━━━━━━━━━━━━━━━━━━━━"

			comment "⚠️	Required:	✗ Power Management"
				depends on !PM_ENABLE
			comment "	  Enable: Component config → Power Management"
				depends on !PM_ENABLE

			comment "⚠️	Required:	✗ FreeRTOS Tickless Idle"
				depends on !FREERTOS_USE_TICKLESS_IDLE
			comment "	  Enable: Component config → FreeRTOS → Kernel → Tickless Idle"
				depends on !FREERTOS_USE_TICKLESS_IDLE

			comment "⚠️	Required:	✗ BT Modem Sleep (ESP32)"
				depends on BT_ENABLED && !BTDM_CTRL_MODEM_SLEEP && IDF_TARGET_ESP32
			comment "	  Enable: Component config → Bluetooth → Modem Sleep"
				depends on BT_ENABLED && !BTDM_CTRL_MODEM_SLEEP && IDF_TARGET_ESP32

			comment "⚠️	Required:	✗ BT LE Sleep (other chips)"
				depends on BT_ENABLED && !BT_LE_SLEEP_ENABLE && !IDF_TARGET_ESP32
			comment "	  Enable: Component config → Bluetooth → Controller Options → Enable BLE sleep"
				depends on BT_ENABLED && !BT_LE_SLEEP_ENABLE && !IDF_TARGET_ESP32

			comment "⚠️	Required:	✗ MAC BB Power Down (if BT enabled)"
				depends on BT_ENABLED && !ESP_PHY_MAC_BB_PD
			comment "	  Enable: Component config → PHY → Power Management → MAC BB power down"
				depends on BT_ENABLED && !ESP_PHY_MAC_BB_PD

			comment "ⓘ	Recommended: Power down Digital Peripheral in light sleep"
				depends on !PM_POWER_DOWN_PERIPHERAL_IN_LIGHT_SLEEP
			comment "	  Enable: Component config → Power Management → Power down Digital Peripheral"
				depends on !PM_POWER_DOWN_PERIPHERAL_IN_LIGHT_SLEEP

			comment "✓ All prerequisites configured correctly!"
				depends on PM_ENABLE && FREERTOS_USE_TICKLESS_IDLE && (!BT_ENABLED || (ESP_PHY_MAC_BB_PD && ((IDF_TARGET_ESP32 && BTDM_CTRL_MODEM_SLEEP) || (!IDF_TARGET_ESP32 && BT_LE_SLEEP_ENABLE))))

			comment "━━━━━━━━━━━━━━━━━━━━━━━━━━━━━━━━━━━━━━━━━━━━━━━━━━━━"
		endif

		# Show clean status for MIN/MAX modes
		if ESP_HOSTED_LIGHT_SLEEP_POWER_MIN
			comment "━━━━━━━━━━━━━━━━━━━━━━━━━━━━━━━━━━━━━━━━━━━━━━━━━━━━"
			comment "✓ Minimum Power Mode Active"
			comment "  • All prerequisites auto-configured"
			comment "  • UART console available during sleep"
			comment "  • Good for development and debugging"
			comment "━━━━━━━━━━━━━━━━━━━━━━━━━━━━━━━━━━━━━━━━━━━━━━━━━━━━"
		endif

		if ESP_HOSTED_LIGHT_SLEEP_POWER_MAX
			comment "━━━━━━━━━━━━━━━━━━━━━━━━━━━━━━━━━━━━━━━━━━━━━━━━━━━━"
			comment "✓ Maximum Power Mode Active"
			comment "  • All prerequisites auto-configured"
			comment "  • UART console disabled during sleep"
			comment "  • Optimized for battery applications"
			comment "━━━━━━━━━━━━━━━━━━━━━━━━━━━━━━━━━━━━━━━━━━━━━━━━━━━━"
		endif

		config ESP_HOSTED_LIGHT_SLEEP_MIN_FREQ_MHZ
			int "Minimum CPU frequency (MHz)"
			default 10 if IDF_TARGET_ESP32
			default 10 if IDF_TARGET_ESP32S2
			default 10 if IDF_TARGET_ESP32S3
			default 10 if IDF_TARGET_ESP32C2
			default 10 if IDF_TARGET_ESP32C3
			default 12 if IDF_TARGET_ESP32C5
			default 10 if IDF_TARGET_ESP32C6 || IDF_TARGET_ESP32C61
			default 10 if IDF_TARGET_ESP32H2
			range 10 240 if IDF_TARGET_ESP32 || IDF_TARGET_ESP32S2 || IDF_TARGET_ESP32S3 || IDF_TARGET_ESP32C3 || IDF_TARGET_ESP32C6
			range 10 80 if IDF_TARGET_ESP32C2 || IDF_TARGET_ESP32H2
			range 12 96 if IDF_TARGET_ESP32C5
			help
				CPU frequency when idle. Lower = more power saving.

				Chipset frequency ranges:
				  ESP32/S2/S3: 10-240 MHz
				  ESP32-C2/H2: 10-80 MHz
				  ESP32-C3:    10-160 MHz
				  ESP32-C5:    12-96 MHz
				  ESP32-C6:    10-160 MHz

		# ESP-Hosted specific power options (only shown in Manual and Max modes)
		menu "Advanced Light Sleep Config"
			depends on ESP_HOSTED_LIGHT_SLEEP_POWER_MANUAL
			visible if ESP_HOSTED_LIGHT_SLEEP_POWER_MANUAL

			comment "ⓘ	Tip: Also enable 'Unload BUS driver during host sleep'"
				depends on !ESP_HOSTED_UNLOAD_BUS_DRIVER_DURING_HOST_SLEEP
			comment "	  (Example Configuration → Allow host to power save → Unload...)"
				depends on !ESP_HOSTED_UNLOAD_BUS_DRIVER_DURING_HOST_SLEEP

			comment "ⓘ  Recommended: Power down Digital Peripheral in light sleep"
				depends on !PM_POWER_DOWN_PERIPHERAL_IN_LIGHT_SLEEP
			comment "     Enable: Component config → Power Management → Power down Digital Peripheral"
				depends on !PM_POWER_DOWN_PERIPHERAL_IN_LIGHT_SLEEP

			config ESP_HOSTED_LIGHT_SLEEP_PERIPHERAL_POWERDOWN
				bool "Power down peripherals in light sleep (disables UART console)"
				depends on ESP_HOSTED_UNLOAD_BUS_DRIVER_DURING_HOST_SLEEP && PM_POWER_DOWN_PERIPHERAL_IN_LIGHT_SLEEP
				default y if ESP_HOSTED_LIGHT_SLEEP_POWER_MAX
				default n
				help
					Disables UART console during sleep for maximum power saving.

					REQUIREMENTS:
					• Bus driver unload during host sleep (ESP-Hosted option)
					• PM peripheral powerdown (Component config)

					RECOMMENDED FOR:
					• Production deployments
					• Battery-powered applications

		endmenu

		# General recommendations (always visible for reference)
		menu "Additional Recommendations"
			comment "ⓘ	WiFi: Enable WiFi Modem Sleep"
				depends on SOC_WIFI_SUPPORTED
			comment "	  Component config → Wi-Fi → WiFi Power Management"
				depends on SOC_WIFI_SUPPORTED

			comment "ⓘ	WiFi 6: Use ITWT for better power saving"
				depends on SOC_WIFI_HE_SUPPORT
			comment "	  Example: esp-hosted-mcu/examples/host_wifi_itwt"
				depends on SOC_WIFI_HE_SUPPORT

			comment "ⓘ	Bluetooth: Disable if not needed"
				depends on BT_ENABLED
			comment "	  Component config → Bluetooth → [ ] Bluetooth"
				depends on BT_ENABLED
		endmenu

	endmenu

endmenu
```

## components/espressif__esp_hosted/slave/main/Kconfig.openthread
```kconfig
if !OPENTHREAD_RADIO
	comment "Radio Only Device must be selected:"
	comment "Component config"
	comment "└── OpenThread"
	comment "    └── Thread Core Features"
	comment "        └── Thread device type ──> Radio Only Device"
endif
if OPENTHREAD_COMMISSIONER
	comment "Disable Commissioner:"
	comment "Component config"
	comment "└── OpenThread"
	comment "    └── Thread Core Features"
	comment "        └── [ ] Enable Commissioner"
endif
if OPENTHREAD_JOINER
	comment "Disable Joiner:"
	comment "Component config"
	comment "└── OpenThread"
	comment "    └── Thread Core Features"
	comment "        └── [ ] Enable Joiner"
endif
if OPENTHREAD_SRP_CLIENT
	comment "Disable SRP Client:"
	comment "Component config"
	comment "└── OpenThread"
	comment "    └── Thread Core Features"
	comment "        └── [ ] Enable SRP Client"
endif
if OPENTHREAD_DNS_CLIENT
	comment "Disable DNS Client:"
	comment "Component config"
	comment "└── OpenThread"
	comment "    └── Thread Core Features"
	comment "        └── [ ] Enable DNS Client"
endif
comment " :warning: OpenThread UART port and Hosted UART transport port is same — pick a different UART port"
	depends on ESP_UART_HOST_INTERFACE && ESP_HOSTED_OT_UART_PORT = ESP_UART_PORT

choice ESP_HOSTED_OT_INTERFACE
	bool "OpenThread Transport"
	default ESP_HOSTED_OT_TRANSPORT_UART
	help
		Transport used communicate with OpenThread Host

	config ESP_HOSTED_OT_TRANSPORT_HOSTED
		bool "Use ESP-Hosted Transport"
		help
			Use ESP-Hosted transport to communicate with OpenThread Host

	config ESP_HOSTED_OT_TRANSPORT_UART
		bool "UART"
		help
			Use dedicated UART to communicate with OpenThread Host
endchoice

if ESP_HOSTED_OT_TRANSPORT_UART

	config ESP_HOSTED_OT_UART_PORT
		int "UART Port to Use"
		default 1
		range 0 1
		help
			Select UART Port to Use. Do not select the UART Port used for console output (if enabled)

	config ESP_HOSTED_OT_UART_PIN_TX
		int "TX GPIO number"
		default 14 if IDF_TARGET_ESP32C5
		default 21 if IDF_TARGET_ESP32C6
		default 12 if IDF_TARGET_ESP32H2
		default 17 if IDF_TARGET_ESP32H4
		help
			GPIO used for UART TX

	config ESP_HOSTED_OT_UART_PIN_RX
		int "RX GPIO number"
		default 13 if IDF_TARGET_ESP32C5
		default 20 if IDF_TARGET_ESP32C6
		default 22 if IDF_TARGET_ESP32H2
		default 18 if IDF_TARGET_ESP32H4
		help
			GPIO used for UART RX

	config ESP_HOSTED_OT_UART_BAUDRATE
		int "Baud Rate"
		default 460800
		range 9600 3500000
		help
			Baud Rate to Use. Make sure Hardware supports the rate.
			Standard rates are 9600, 19200, 38400, 57600, 115200, 460800, 921600

	choice ESP_HOSTED_OT_UART_PRIV_NUM_DATA_BITS
		bool "Number of Data Bits"
		default ESP_HOSTED_OT_UART_PRIV_NUM_DATA_BITS_8
		help
			Number of Data Bits to use

		config ESP_HOSTED_OT_UART_PRIV_NUM_DATA_BITS_5
			bool "5 Bits"

		config ESP_HOSTED_OT_UART_PRIV_NUM_DATA_BITS_6
			bool "6 Bits"

		config ESP_HOSTED_OT_UART_PRIV_NUM_DATA_BITS_7
			bool "7 Bits"

		config ESP_HOSTED_OT_UART_PRIV_NUM_DATA_BITS_8
			bool "8 Bits"
	endchoice

	config ESP_HOSTED_OT_UART_NUM_DATA_BITS
		int
		default 0 if ESP_HOSTED_OT_UART_PRIV_NUM_DATA_BITS_5
		default 1 if ESP_HOSTED_OT_UART_PRIV_NUM_DATA_BITS_6
		default 2 if ESP_HOSTED_OT_UART_PRIV_NUM_DATA_BITS_7
		default 3 if ESP_HOSTED_OT_UART_PRIV_NUM_DATA_BITS_8

	choice ESP_HOSTED_OT_UART_PRIV_PARITY
		bool "Parity"
		default ESP_HOSTED_OT_UART_PRIV_PARITY_NONE

		config ESP_HOSTED_OT_UART_PRIV_PARITY_NONE
			bool "None"

		config ESP_HOSTED_OT_UART_PRIV_PARITY_EVEN
			bool "Even"

		config ESP_HOSTED_OT_UART_PRIV_PARITY_ODD
			bool "Odd"
	endchoice

	config ESP_HOSTED_OT_UART_PARITY
		int
		default 0 if ESP_HOSTED_OT_UART_PRIV_PARITY_NONE
		default 2 if ESP_HOSTED_OT_UART_PRIV_PARITY_EVEN
		default 3 if ESP_HOSTED_OT_UART_PRIV_PARITY_ODD

	choice ESP_HOSTED_OT_UART_PRIV_STOP_BITS
		bool "Number of Stop Bits"

		config ESP_HOSTED_OT_UART_PRIV_STOP_BITS_1
			bool "1"

		config ESP_HOSTED_OT_UART_PRIV_STOP_BITS_1_5
			bool "1.5"

		config ESP_HOSTED_OT_UART_PRIV_STOP_BITS_2
			bool "2"
	endchoice

	config ESP_HOSTED_OT_UART_STOP_BITS
		int
		default 1 if ESP_HOSTED_OT_UART_PRIV_STOP_BITS_1
		default 2 if ESP_HOSTED_OT_UART_PRIV_STOP_BITS_1_5
		default 3 if ESP_HOSTED_OT_UART_PRIV_STOP_BITS_2

endif

config ESP_HOSTED_OT_NETIF_QUEUE_SIZE
	int "OpenThread Network Interface Queue Size"
	default 10
	help
		The packet queue size for the OpenThread network interface

config ESP_HOSTED_OT_TASK_QUEUE_SIZE
	int "OpenThread Task Queue Size"
	default 10
	help
		The OpenThread task queue size
```
